## conf/distro/gei.conf
```bitbake
require conf/distro/poky.conf

# Add bluetooth
DISTRO_FEATURES_append = " bluetooth bluez5"

# Use systemd
DISTRO_FEATURES_append = " systemd"
VIRTUAL-RUNTIME_init_manager = "systemd"

DISTRO_FEATURES_BACKFILL_CONSIDERED = "sysvinit"

VIRTUAL-RUNTIME_initscripts = ""
```

## conf/layer.conf
```bitbake
# We have a conf and classes directory, add to BBPATH
BBPATH .= ":${LAYERDIR}"

# We have recipes-* directories, add to BBFILES
BBFILES += "${LAYERDIR}/recipes-*/*/*.bb \
	${LAYERDIR}/recipes-*/*/*.bbappend"

BBFILE_COLLECTIONS += "meta-gei"
BBFILE_PATTERN_meta-gei = "^${LAYERDIR}/"
BBFILE_PRIORITY_meta-gei = "6"
```
